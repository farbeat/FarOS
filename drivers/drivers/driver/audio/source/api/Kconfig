## drivers/drivers/driver/audio/source/api/Kconfig
```kconfig
menu "Audio API Config"

config SAP_DUMP_SUPPORT
    bool "enable dump"
    default n
    help
        enable dump in MPI

config SAP_AI_DUMP_SUPPORT
    bool "ai dump support"
    default n
    depends on SAP_DUMP_SUPPORT
    help
        enable ai dump in MPI

config SAP_SEA_DUMP_SUPPORT
    bool "sea dump support"
    default n
    depends on SAP_DUMP_SUPPORT
    help
        enable sea dump in MPI

config SAP_ADEC_DUMP_SUPPORT
    bool "adec dump support"
    default n
    depends on SAP_DUMP_SUPPORT
    help
        enable adec dump in MPI

config SAP_AENC_DUMP_SUPPORT
    bool "aenc dump support"
    default n
    depends on SAP_DUMP_SUPPORT
    help
        enable aenc dump in MPI

config SAP_TRACK_DUMP_SUPPORT
    bool "track dump support"
    default n
    depends on SAP_DUMP_SUPPORT
    help
        enable track dump in MPI

config SAP_AO_DUMP_SUPPORT
    bool "ao dump support"
    default n
    depends on SAP_DUMP_SUPPORT
    help
        enable ao dump in MPI

endmenu
```

## drivers/drivers/driver/audio/source/drv/Kconfig
```kconfig
menu "Audio Driver Config"

config SAP_PROC_SUPPORT
    bool "proc support"
    default y

###########################################################
choice
    prompt "Proc Type"
    default SAP_PROC_TYPE_DUMMY

config SAP_PROC_TYPE_DUMMY
    bool "dummy"
    help
        set proc type to dummy

config SAP_PROC_TYPE_REAL
    bool "real"
    help
        set proc type to real
endchoice

###########################################################
config SAP_PROC_OUTPUT_UART
    bool "enable uart output"
    default y
    depends on SAP_PROC_TYPE_DUMMY
    help
        enable proc output to uart

config SAP_PROC_OUTPUT_DIAG_SHELL
    bool "enable diag shell output"
    default n
    depends on SAP_PROC_TYPE_DUMMY
    help
        enable proc output to diag shell

config SAP_PROFILE_SUPPORT
    bool "profile support"
    default n

config SAP_MEM_STATISTIC
    bool "open malloc statistic"
    default n

config SAP_MCPS_STATISTIC
    bool "open cpu mcps statistic"
    default n

config SAP_ANC_SUPPORT
    bool "anc support"
    default n

config SAP_LPC_SUPPORT
    bool "lpc support"
    default n

config SAP_DSP_I2C_SUPPORT
    bool "dsp i2c support"
    default n

config SAP_FLASH_FIRMWARE_SUPPORT
    bool "flash firmware support"
    default n

###########################################################
choice
    prompt "Overlay Location"
    default SAP_DRV_OVERLAY_LOAD_FROM_FLASH

config SAP_DRV_OVERLAY_LOAD_FROM_FLASH
    bool "flash"
    help
        load overlay from flash

config SAP_DRV_OVERLAY_LOAD_FROM_FILE
    bool "file system"
    help
        load overlay from file system
endchoice

config SAP_DRV_OVERLAY_LOAD_FROM
    string
    default "flash"          if SAP_DRV_OVERLAY_LOAD_FROM_FLASH
    default "file"           if SAP_DRV_OVERLAY_LOAD_FROM_FILE

###########################################################
config SAP_SHELL_SUPPORT
	bool "dsp shell support"
    default y

config SAP_TEST_CORE_SUPPORT
	bool "dsp test cases support"
    default y

config SAP_HAID_SUPPORT
	bool "hearing aid support"
    default n

###########################################################
config SAP_IPC_LOG_SUPPORT
	bool "ipc log support"
    default y          if SAP_BRANDY
    default n          if SAP_SOCMN1

###########################################################
config SAP_SUPPORT_RT_SMALL_MEM
    bool "rt-thread small mem support"
    default n

###########################################################

endmenu
```

## drivers/drivers/hal/memory_monitor/Kconfig
```kconfig
#===============================================================================
# @brief    Kconfig file.
# Copyright (c) @CompanyNameMagicTag 2023-2023. All rights reserved.
#===============================================================================
config MEM_MONITOR_USING_V150
    bool
    prompt "Using MEM_Monitor V150"
    default y
    depends on DRIVER_SUPPORT_MEM_MONITOR

config MEM_MONITOR_DEBUG
    bool
    prompt "Opening MEM_Monitor Debug"
    default y
    depends on DRIVER_SUPPORT_MEM_MONITOR
```

## drivers/drivers/hal/pwm/Kconfig
```kconfig
#===============================================================================
# @brief    Kconfig file.
# Copyright (c) @CompanyNameMagicTag 2022-2022. All rights reserved.
#===============================================================================
config PWM_USING_V151
    bool
    prompt "Using PWM V151"
    default y
    depends on DRIVER_SUPPORT_PWM

config PWM_USING_V150
    bool
    prompt "Using PWM V150"
    default y
    depends on DRIVER_SUPPORT_PWM

config PWM_GROUP_NUM
    int
    prompt "number of groups in PWM"
    range 1 16
    default 6
    depends on DRIVER_SUPPORT_PWM
```

## drivers/drivers/hal/timer/Kconfig
```kconfig
#===============================================================================
# @brief    Kconfig file.
# Copyright (c) HiSilicon (Shanghai) Technologies Co., Ltd. 2022-2022. All rights reserved.
#===============================================================================
config TIMER_USING_V100
    bool
    prompt "Using Timer V100."
    default y
    depends on DRIVER_SUPPORT_TIMER

config TIMER_USING_V150
    bool
    prompt "Using Timer V150."
    default y
    depends on DRIVER_SUPPORT_TIMER

config TIMER_MAX_NUM
    int
    prompt "Timer max low layer nums."
    default 8
    depends on DRIVER_SUPPORT_TIMER

config TIMER_0_WIDTH_64
    int
    prompt "Using 64 bits width of Timer0."
    range 0 1
    default 0
    depends on TIMER_USING_V150

config TIMER_1_WIDTH_64
    int
    prompt "Using 64 bits width of Timer1."
    range 0 1
    default 0
    depends on TIMER_USING_V150 && TIMER_MAX_NUM > 1

config TIMER_2_WIDTH_64
    int
    prompt "Using 64 bits width of Timer2."
    range 0 1
    default 0
    depends on TIMER_USING_V150 && TIMER_MAX_NUM > 2

config TIMER_3_WIDTH_64
    int
    prompt "Using 64 bits width of Timer3."
    range 0 1
    default 0
    depends on TIMER_USING_V150 && TIMER_MAX_NUM > 3

config TIMER_4_WIDTH_64
    int
    prompt "Using 64 bits width of Timer4."
    range 0 1
    default 1
    depends on TIMER_USING_V150 && TIMER_MAX_NUM > 4

config TIMER_5_WIDTH_64
    int
    prompt "Using 64 bits width of Timer5."
    range 0 1
    default 1
    depends on TIMER_USING_V150 && TIMER_MAX_NUM > 5

config TIMER_6_WIDTH_64
    int
    prompt "Using 64 bits width of Timer6."
    range 0 1
    default 1
    depends on TIMER_USING_V150 && TIMER_MAX_NUM > 6

config TIMER_7_WIDTH_64
    int
    prompt "Using 64 bits width of Timer7."
    range 0 1
    default 1
    depends on TIMER_USING_V150 && TIMER_MAX_NUM > 7
```

## drivers/drivers/hal/uart/Kconfig
```kconfig
#===============================================================================
# @brief    Kconfig file.
# Copyright (c) @CompanyNameMagicTag 2022-2022. All rights reserved.
#===============================================================================
config UART_DLF_SIZE
    int
    prompt "UART_DLF_SIZE"
    range 4 6
    default 4
    depends on DRIVER_SUPPORT_UART

config UART_USING_V120
    bool
    prompt "Using UART V120"
    default y
    depends on DRIVER_SUPPORT_UART

config UART_USING_V151
    bool
    prompt "Using UART V151"
    default y
    depends on DRIVER_SUPPORT_UART

config UART_USING_V100
    bool
    prompt "Using UART V100"
    default n
    depends on DRIVER_SUPPORT_UART

config UART_BAUDSET_WAITTIMES_LIMIT
    int
    prompt "the wait loop times when change baudrate for uartv100"
    default 1000
    depends on UART_USING_V100
```

## kernel/liteos/liteos_v207.1.0/Huawei_LiteOS/targets/Kconfig.aiot
```kconfig
config LOSCFG_PLATFORM
    string
    default "ws63"            if LOSCFG_PLATFORM_WS63
    default "brandy_app"      if LOSCFG_PLATFORM_BRANDY_APP
    default "sushik_app"      if LOSCFG_PLATFORM_SUSHIK_APP
    default "socmn1"          if LOSCFG_PLATFORM_SOCMN1

choice
    prompt "Board"
    depends on LOSCFG_FAMILY_AIOT
    default LOSCFG_PLATFORM_WS63


config LOSCFG_PLATFORM_WS63
    bool "ws63"
    select LOSCFG_ARCH_RISCV_RV32IMC
    select LOSCFG_RISCV_HIMIDEERV200_PLIC
    select LOSCFG_TIMER_VENDOR
    select LOSCFG_DRIVERS_UART_VENDOR
    select LOSCFG_USING_BOARD_LD
    select LOSCFG_ARCH_RISCV_RV32F
    select LOSCFG_ARCH_RISCV32
    select LOSCFG_USING_BOARD_RESET_VECTOR

config LOSCFG_PLATFORM_BRANDY_APP
    bool "brandy_app"
    select LOSCFG_ARCH_LINXCORE_170
    select LOSCFG_ARCH_RISCV_RV32F
    select LOSCFG_LCMP_CUSTOM_INST16_EXTENSIONS
    select LOSCFG_LCMP_CUSTOM_INST16_SUB_EXTENSIONS
    select LOSCFG_LCMP_CUSTOM_INST32_EXTENSIONS
    select LOSCFG_TIMER_VENDOR
    select LOSCFG_DRIVERS_UART_VENDOR
    select LOSCFG_USING_BOARD_LD
    select LOSCFG_USING_BOARD_RESET_VECTOR

config LOSCFG_PLATFORM_SUSHIK_APP
    bool "sushik_app"
    select LOSCFG_ARCH_CORTEX_M7
    select LOSCFG_CORTEX_M_NVIC
    select LOSCFG_TIMER_VENDOR
    select LOSCFG_DRIVERS_UART_VENDOR
    select LOSCFG_USING_BOARD_LD

config LOSCFG_PLATFORM_SOCMN1
    bool "socmn1"
    select LOSCFG_ARCH_CORTEX_M7
    select LOSCFG_ARCH_FPU_VFP_DP
    select LOSCFG_CORTEX_M_SYSTICK
    select LOSCFG_USING_BOARD_LD
    select LOSCFG_DRIVERS_UART_VENDOR

endchoice
```

## kernel/liteos/liteos_v207.1.0/Huawei_LiteOS/targets/Kconfig.energy
```kconfig
config LOSCFG_PLATFORM
    string
    default "hc32f4a0"       if LOSCFG_PLATFORM_HC32F4A0
    default "sd5010"         if LOSCFG_PLATFORM_SD5010
    default "stm32h747m4"    if LOSCFG_PLATFORM_STM32H747M4

choice
    prompt "Board"
    depends on LOSCFG_FAMILY_ENERGY
    default LOSCFG_PLATFORM_HC32F4A0

config LOSCFG_PLATFORM_HC32F4A0
    bool "hc32f4a0"
    select LOSCFG_ARCH_CORTEX_M4
    select LOSCFG_CORTEX_M_NVIC
    select LOSCFG_CORTEX_M_SYSTICK
    select LOSCFG_USING_BOARD_LD
    select LOSCFG_DRIVERS_UART_VENDOR

config LOSCFG_PLATFORM_SD5010
    bool "sd5010"
    select LOSCFG_ARCH_ARM_926
    select LOSCFG_ARM_V5_VIC
    select LOSCFG_TIMER_VENDOR
    select LOSCFG_DRIVERS_UART_VENDOR

config LOSCFG_PLATFORM_STM32H747M4
    bool "stm32h747m4"
    select LOSCFG_ARCH_CORTEX_M4
    select LOSCFG_CORTEX_M_NVIC
    select LOSCFG_CORTEX_M_SYSTICK
    select LOSCFG_USING_BOARD_LD
    select LOSCFG_DRIVERS_UART_VENDOR

endchoice
```

## middleware/utils/fs/yaffs2/os_adapt/adapt_ohos/Kconfig
```kconfig
config FS_YAFFS
    bool "Enable YAFFS2"
    default y
    depends on FS_VFS && DRIVERS_MTD_NAND
    help
      Answer Y to enable LiteOS support yaffs2 filesystem.
```
